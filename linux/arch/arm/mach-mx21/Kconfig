## linux/arch/arm/mach-mx21/Kconfig
```kconfig
menu "MX21 Options"
	depends on ARCH_MX21

config MX21_OPTIONS
	bool
	default y
	select CPU_ARM926T
	select MXC_EMMA

config MACH_MX21ADS
	bool "Support MX21 ADS platforms"
	default y
	help
	  Include support for MX21 ADS platform. This includes specific
	  configurations for the board and its peripherals.

endmenu
```

## linux/drivers/mxc/pm/Kconfig
```kconfig
#
# Power Managment devices
#

menu "Advanced Power Management devices"

config MX27_DPTC
	bool "MXC DPTC driver"
	depends on ARCH_MX27 && MXC_PMIC_MC13783
	default y
	help
	   This selects the Freescale MX27 Internal DPTC driver.
	   If unsure, say N.

endmenu
```
